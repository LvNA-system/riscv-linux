## arch/riscv/label/Kconfig
```kconfig
config CGROUP_DSID
	tristate "LABEL_MODULE IN RISCV"
	default y	
	help
	this is a label task struct static module
```

## arch/riscv/lable/Kconfig
```kconfig
config LABLE_MODULE_IN_RISCV
	tristate "LABLE_MODULE IN RISCV"
	default y	
	help
	this is a lable task struct static module
```
